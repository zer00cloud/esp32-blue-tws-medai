## sdkconfig.defaults
```kconfig
# Bluetooth Classic + A2DP Source
CONFIG_BT_ENABLED=y
CONFIG_BT_BLUEDROID_ENABLED=y
CONFIG_BT_CONTROLLER_ENABLED=y
CONFIG_BT_CLASSIC_ENABLED=y
CONFIG_BT_A2DP_ENABLE=y
CONFIG_BT_A2DP_USE_EXTERNAL_CODEC=n
CONFIG_BT_AVRCP_CT_COVER_ART_ENABLED=y
CONFIG_BT_GOEPC_ENABLED=y
CONFIG_BT_BLE_ENABLED=n

# Flash size
CONFIG_ESPTOOLPY_FLASHSIZE_4MB=y
```
